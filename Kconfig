## Kconfig
```kconfig
menu "Express"

    config EXPRESS_USE_AUTH
        bool "Use build in AUTH in Express"
        default n
        help
            Use build in session and withAuth middleware in Express Web Server.


endmenu
```
